## dts/bindings/charger/nxp,pca9422-charger.yaml
```yaml
# Copyright 2025 NXP
# SPDX-License-Identifier: Apache-2.0

description: NXP PCA9422 battery charger

include: battery.yaml

compatible: "nxp,pca9422-charger"

properties:
  constant-charge-current-max-microamp:
    type: int
    required: true
    default: 100000
    description: |
      Fast Charge current set at init time in uA, available range is 2.5mA to 640mA.
      The value specified will be rounded down to the closest implemented
      value. If set to 0 (default) skip setting the charge current value at
      driver initialization.

  constant-charge-current-max-microamp-cool-temp:
    type: int
    description: |
      Fast Charge current programmed into I_FAST_CHG while the charger
      temperature is in the cool region. The selected cool-charge-current-percent
      is applied to this value. If cool-charge-current-percent is omitted, this
      property defaults the cool region to 25%. For example, 465000 uA selects
      the 5mA step and code 92. With cool-charge-current-percent = 25, the PMIC
      yields 5mA + 0.25 * 92 * 5mA = 120mA.

  cold-temperature-threshold-celsius:
    type: int
    enum:
      - -10
      - -5
      - 0
      - 5
    default: 0
    description: |
      Cold temperature threshold in degrees Celsius. Maps to the VCOLD_0C field.

  cool-temperature-threshold-celsius:
    type: int
    enum:
      - 0
      - 5
      - 10
      - 15
    default: 10
    description: |
      Cool temperature threshold in degrees Celsius. Maps to the VCOOL_10C field.

  warm-temperature-threshold-celsius:
    type: int
    enum:
      - 35
      - 40
      - 45
      - 50
    default: 45
    description: |
      Warm temperature threshold in degrees Celsius. Maps to the VWARM_45C field.

  warm-plus-temperature-threshold-celsius:
    type: int
    enum:
      - 35
      - 40
      - 45
      - 50
    default: 45
    description: |
      Warm plus temperature threshold in degrees Celsius. Maps to the VWARM_50C field.

  hot-temperature-threshold-celsius:
    type: int
    enum:
      - 45
      - 50
      - 55
      - 60
    default: 45
    description: |
      Hot temperature threshold in degrees Celsius. Maps to the VHOT_60C field.

  cool-charge-current-percent:
    type: int
    enum:
      - 100
      - 75
      - 50
      - 25
    description: |
      Charge current percentage applied in the cool temperature region. If
      omitted, charging stays at 100% unless constant-charge-current-max-microamp-cool-temp
      is present, in which case the driver uses 25% for compatibility.

  warm-charge-current-percent:
    type: int
    enum:
      - 100
      - 75
      - 50
      - 25
    description: |
      Charge current percentage applied in the warm temperature region. If
      omitted, charging stays at 100%.

  warm-plus-charge-current-percent:
    type: int
    enum:
      - 100
      - 75
      - 50
      - 25
    description: |
      Charge current percentage applied in the warm plus temperature region. If
      omitted, charging stays at 100%.

  disable-charging-at-cold-temperature:
    type: boolean
    description: |
      Disable charging when the cold temperature region is detected. The PCA9422
      has a shared cold/hot hardware disable bit; if only this property is set,
      the driver handles cold-only disable in software.

  disable-charging-at-hot-temperature:
    type: boolean
    description: |
      Disable charging when the hot temperature region is detected. The PCA9422
      has a shared cold/hot hardware disable bit; if only this property is set,
      the driver handles hot-only disable in software.

  constant-charge-voltage-max-microvolt:
    type: int
    required: true
    default: 4200000
    description: |
      The maximum voltage that the battery will be charged at, defaults to
      4.2V, matching the device default reset configuration.

  precharge-current-percent:
    type: int
    enum:
      - 7
      - 16
    default: 16
    description: |
      Precharge current as x%(7% or 16%) of Fast charge current.
      Refer to CHARGER_CNTL_1 register description for details.

  charge-termination-current-percent:
    type: int
    enum:
      - 25
      - 50
      - 75
      - 100
    default: 25
    description: |
      Topoff current as x%*10 (2.5%, 5.0%, 7.5%, or 10.0%)
      of Fast charge current. Charge will finish when charging
      current is less than topoff current.
      Refer to CHARGER_CNTL_4 register description for details.

  re-charge-threshold-microvolt:
    type: int
    enum:
      - 100000
      - 150000
      - 200000
    default: 100000
    description: |
      Recharge threshold in relation to Vbat_reg.
      Refer to CHARGER_CNTL_4 register description for details.

  input-current-limit-microamp:
    type: int
    default: 470000
    description: |
      Input current limit on VIN, available range is 45mA to 1195mA.

  system-voltage-min-threshold-microvolt:
    type: int
    default: 4550000
    description: |
      System regulation voltage. It is higher 200mV than Vbat_reg.
      Vbatreg will clamp by Vsys_reg - 200mV.
```
