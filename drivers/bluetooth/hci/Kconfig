## drivers/bluetooth/hci/Kconfig
```kconfig
# Bluetooth drivers configuration options

# Copyright (c) 2016 Intel Corporation
# SPDX-License-Identifier: Apache-2.0

comment "Bluetooth HCI Driver Options"

config BT_UART
	bool

choice BT_HCI_BUS_TYPE
	prompt "Bluetooth HCI driver"

config BT_H4
	bool "H:4 UART"
	select UART_INTERRUPT_DRIVEN
	select BT_UART
	select BT_RECV_IS_RX_THREAD
	depends on SERIAL
	help
	  Bluetooth H:4 UART driver. Requires hardware flow control
	  lines to be available.

config BT_H5
	bool "H:5 UART [EXPERIMENTAL]"
	select UART_INTERRUPT_DRIVEN
	select BT_UART
	depends on SERIAL
	help
	  Bluetooth three-wire (H:5) UART driver. Implementation of HCI
	  Three-Wire UART Transport Layer.

config BT_IPC
	bool "HCI using IPC"
	help
	  Bluetooth HCI driver for communication with another CPU.

config BT_SPI
	bool "SPI HCI"
	depends on SPI
	help
	  Supports Bluetooth ICs using SPI as the communication protocol.
	  HCI packets are sent and received as single Byte transfers,
	  prepended after a known header.  Headers may vary per device, so
	  additional platform specific knowledge may need to be added as
	  devices are.

config BT_STM32_IPM
	bool "IPM HCI"
	select USE_STM32_HAL_CORTEX
	select HAS_STM32LIB
	help
	  TODO

config BT_USERCHAN
	bool "HCI User Channel based driver"
	depends on BOARD_NATIVE_POSIX
	help
	  This driver provides access to the local Linux host's Bluetooth
	  adapter using a User Channel HCI socket to the Linux kernel. It
	  is only intended to be used with the native POSIX build of Zephyr.
	  The Bluetooth adapter must be powered off in order for Zephyr to
	  be able to use it.

config BT_NO_DRIVER
	bool "No default HCI driver"
	help
	  This is intended for unit tests where no internal driver
	  should be selected.

endchoice

# Workaround for not being able to have commas in macro arguments
DT_CHOSEN_Z_BT_UART := zephyr,bt-uart

config BT_UART_ON_DEV_NAME
	string "Device Name of UART Device for Bluetooth"
	default "$(dt_chosen_label,$(DT_CHOSEN_Z_BT_UART))" if HAS_DTS
	default "UART_0"
	depends on BT_UART
	help
	  This option specifies the name of UART device to be used
	  for Bluetooth.

if BT_SPI

config BT_SPI_INIT_PRIORITY
	int "BT SPI init priority"
	default 75

config BT_BLUENRG_ACI
	bool "Enable ACI message with with BlueNRG-based devices"
	help
	  Enable support for devices compatible with the BlueNRG Bluetooth
	  Stack. Current driver supports: ST BLUENRG-MS.

config BT_SPI_BLUENRG
	bool "Enable compatibility with BlueNRG-based devices"
	help
	  Enable support for devices compatible with the BlueNRG Bluetooth
	  Stack. Current driver supports: ST BLUENRG-MS.

endif # BT_SPI

config BT_STM32_IPM_RX_STACK_SIZE
	int "STM32 IPM stack size for RX thread"
	depends on BT_STM32_IPM
	default 512

#config BT_IPC
#    bool "IPC for BT HCI in nRF53"
#	default y if SOC_NRF5340_CPUAPP
#	#TODO pisz and BLE ?
#	select IPM
#	select IPM_NRFX
#	#TODO PISZ set channels based on configuration
#	select IPM_MSG_CH_1_ENABLE
#	select IPM_MSG_CH_0_ENABLE
#	select IPM_MSG_CH_0_TX
#	select IPM_MSG_CH_1_RX
#	#depends on BT_IPC_NRF53_RPMSG

#config BT_IPC_NRF53_RPMSG
#	bool "nRF53 configuration of RPMsg"
#	default y if SOC_NRF5340_CPUAPP
#	depends on BT_IPC_RPMSG
#
#	select IPC_BACKEND_OPENAMP
#	help
#	  Enable RPMsg configuration for nRF53. Two channels of the IPM driver
#	  are used in the HCI driver: channel 0 for TX and channel 1 for RX.

if BT_IPC

config BT_IPC_RX_STACK_SIZE
	int "Stack size for IPC RX thread"
	default 1024

config BT_IPC_RX_PRIO
	int "IPC RX thread priority"
	default 8

choice BT_IPC_BACKEND
	prompt "IPC backend to communicate with the BLE controller co-processor"
	default BT_IPC_BACKEND_OPENAMP
	depends on BT_IPC

config BT_IPC_BACKEND_OPENAMP
	bool "OpenAMP IPC backend"
	depends on BT_IPC
	select OPENAMP
	help
	  TODO PISZ

endchoice

config BT_IPC_IPM_DOWNSTREAM_CHANNEL
	int "IPM channel for CPU_APP to CPU_NET communication"
	default 0
	#TODO PISZ check if the number is limited, or int is a good idea

config BT_IPC_IPM_UPSTREAM_CHANNEL
	int "IPM channel for CPU_NET to CPU_APP communication"
	default 1
	#TODO PISZ check if the number is limited, or int is a good idea

endif # BT_IPC

config BT_DRIVER_QUIRK_NO_AUTO_DLE
	bool "Host auto-initiated Data Length Update quirk"
	depends on BT_AUTO_DATA_LEN_UPDATE
	default y if BT_IPC_NRF53
	help
	  Enable the quirk wherein BT Host stack will auto-initiate Data Length
	  Update procedure for new connections for controllers that do not
	  auto-initiate the procedure if the default data length parameters are
	  not equal to the initial parameters.

	  This has to be enabled when the BLE controller connected is Zephyr
	  open source controller.
```

## lib/ipc/Kconfig
```kconfig
#
# Copyright (c) 2020, STMicroelectronics
# Copyright (c) 2020, Nordic Semiconductor ASA
#
# SPDX-License-Identifier: Apache-2.0
#

config IPC
    bool "IPC support"
	default y
	#TODO PISZ set in bluetooth or 53
	help 
	  This enables generic multiinstance interprocessor communications.

if IPC

choice IPC_ROLE
	prompt "Device role in IPC communication"
	default IPC_ROLE_MASTER if IPC_MASTER
	default IPC_ROLE_SLAVE if IPC_SLAVE

config IPC_ROLE_SLAVE
    select OPENAMP_SLAVE
	bool "IPC Role Slave"

config IPC_ROLE_MASTER
	select OPENAMP_MASTER
	bool "IPC Role Master"

endchoice

config IPC_INSTANCES_NO
    int "Number of IPC instances."
    default 1
    help
      How many instances are to be used.

config IPC_ENDPOINTS_NO
    int "Total number of used endpoints."
    default 2
    help
      Number of used endpoints.

config IPC_AUTO_SHMEM_ALLOCATE
    bool "Auto shmem allocation"
    default false
    help
      Auto shared memory allocation for each instance.

config IPC_COPY_NO_BLOCKING
    bool "No blocking message copy."
    default false
    help
      Enables no-copy mechanism for obtaining IPC messages.

config IPC_BACKEND_OPENAMP
	bool "Enable OpenAMP IPC backend"
	select OPENAMP
	default false
	help
      When enabled the OpenAMP backend is used
	  to communicate with the co-processor.

if IPC_BACKEND_OPENAMP

config OPENAMP_RSC_TABLE
	bool "Co-processor resource table"
	imply OPENAMP
	help
	  Add the resource table in the generated binary. This table is
	  compatible with linux remote proc framework and OpenAMP library.

config OPENAMP_RSC_TABLE_NUM_RPMSG_BUFF
	int "Resource table number of rpmsg buffers"
	default 0
	depends on OPENAMP_RSC_TABLE
	help
	  This option specifies the number of buffer used in a Vring for
	  interprocessor communication

endif # IPC_BACKEND_OPENAMP

endif # IPC
```

## lib/open-amp/Kconfig
```kconfig
#
# Copyright (c) 2020, STMicroelectronics
# Copyright (c) 2020, Nordic Semiconductor ASA
#
# SPDX-License-Identifier: Apache-2.0
#

config OPENAMP_RSC_TABLE
	bool "coprocessor resource table"
	imply OPENAMP
	help
	  add the resource table in the generated binary. This table is
	  compatible with linux remote proc framework and OpenAMP library.

config OPENAMP_RSC_TABLE_NUM_RPMSG_BUFF
	int "Resource table number of rpmsg buffers"
	default 0
	depends on OPENAMP_RSC_TABLE
	help
	  This option specifies the number of buffer used in a Vring for
	  interprocessor communication

config OPENAMP_INSTANCES_NUM
	int "Number of open-amp instances."
	default 2 if BT_RPMSG_NRF53 && NRF_802154_SER_HOST
	default 2 if BT_HCI_RAW && NRF_802154_SER_RADIO
	default 1
	help
	  How many instances are to be used.
```
